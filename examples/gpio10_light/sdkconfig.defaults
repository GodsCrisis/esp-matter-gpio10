## examples/gpio10_nmos/sdkconfig.defaults
```kconfig
# Chip config
CONFIG_IDF_TARGET="esp32h2"

# Serial flasher config
CONFIG_ESPTOOLPY_FLASHSIZE_4MB=y
CONFIG_ESPTOOLPY_FLASHSIZE="4MB"

# Partition Table
CONFIG_PARTITION_TABLE_CUSTOM=y
CONFIG_PARTITION_TABLE_CUSTOM_FILENAME="partitions.csv"
CONFIG_PARTITION_TABLE_FILENAME="partitions.csv"

# Compiler options
CONFIG_COMPILER_OPTIMIZATION_SIZE=y
CONFIG_COMPILER_OPTIMIZATION_ASSERTIONS_SILENT=y

# Matter/Thread Config
CONFIG_ENABLE_CHIP_SHELL=n
CONFIG_OPENTHREAD_ENABLED=y
CONFIG_OPENTHREAD_BORDER_ROUTER=n
CONFIG_OPENTHREAD_FTD=y

# ESP Matter Config
CONFIG_ESP_MATTER_ENABLE_DATA_MODEL=y
CONFIG_ESP_MATTER_ENABLE_MATTER_SERVER=y

# Log levels
CONFIG_LOG_DEFAULT_LEVEL_INFO=y
CONFIG_LOG_MAXIMUM_LEVEL_INFO=y

# Bluetooth (for commissioning)
CONFIG_ENABLE_CHIP_BLE=y
CONFIG_BT_ENABLED=y
CONFIG_BT_NIMBLE_ENABLED=y
CONFIG_BT_BLUEDROID_ENABLED=n
CONFIG_BT_CONTROLLER_ENABLED=y
CONFIG_BT_CTRL_MODE_BLE_ONLY=y

# Disable WiFi completely
CONFIG_ESP_WIFI_ENABLED=n

# But provide stub values for WiFi configs that Matter SDK expects
CONFIG_ESP_WIFI_STATIC_RX_BUFFER_NUM=10
CONFIG_ESP_WIFI_DYNAMIC_RX_BUFFER_NUM=32
CONFIG_ESP_WIFI_TX_BUFFER_TYPE=1
CONFIG_ESP_WIFI_DYNAMIC_TX_BUFFER_NUM=32
CONFIG_ESP_WIFI_DYNAMIC_RX_MGMT_BUF=5
CONFIG_ESP_WIFI_ESPNOW_MAX_ENCRYPT_NUM=7

# Explicitly disable WiFi in Matter
CONFIG_ENABLE_WIFI_STATION=n
CONFIG_ENABLE_WIFI_AP=n

# NVS
CONFIG_NVS_ENCRYPTION=n

# Networking
CONFIG_ESP_WIFI_ENABLED=n
CONFIG_ETH_ENABLED=n
CONFIG_LWIP_TCPIP_CORE_LOCKING=y

# FreeRTOS
CONFIG_FREERTOS_HZ=1000

# LWIP
CONFIG_LWIP_LOCAL_HOSTNAME="esp-matter-nmos"

# Main task
CONFIG_ESP_MAIN_TASK_STACK_SIZE=4096

# Newlib
CONFIG_NEWLIB_NANO_FORMAT=y
```
